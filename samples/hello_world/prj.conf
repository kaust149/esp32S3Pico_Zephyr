## CMakeLists.txt
```
# SPDX-License-Identifier: Apache-2.0

cmake_minimum_required(VERSION 3.20.0)

# Optional: NumWorks Epsilon module. Set EPSILON_MODULE_DIR to the module folder
# and CONFIG_EPSILON=y in prj.conf (see the module's README).
if(DEFINED ENV{EPSILON_MODULE_DIR})
  list(APPEND ZEPHYR_EXTRA_MODULES $ENV{EPSILON_MODULE_DIR})
endif()

find_package(Zephyr REQUIRED HINTS $ENV{ZEPHYR_BASE})
project(hello_world)

FILE(GLOB app_sources src/*.c)
target_sources(app PRIVATE ${app_sources})
#target_sources(app PRIVATE src/main.c)
```

## prj.conf
```kconfig
# PicoCalc on ESP32-S3-Pico: display (SPI) + southbridge keyboard (I2C).
# No UI toolkit or shell; the application draws to the display itself.

CONFIG_DISPLAY=y
CONFIG_ILI9488=y
CONFIG_SPI=y

CONFIG_GPIO=y
CONFIG_PWM=y

CONFIG_I2C=y
CONFIG_I2C_INIT_PRIORITY=50

# Epsilon (NumWorks) reserves a 32 KiB stack.
CONFIG_MAIN_STACK_SIZE=28672

# NumWorks Epsilon (needs the module, see EPSILON_MODULE_DIR in CMakeLists.txt)
CONFIG_EPSILON=y
CONFIG_CPP=y
CONFIG_STD_CPP23=y
CONFIG_GLIBCXX_LIBCPP=y

CONFIG_LOG=y
CONFIG_LOG_MODE_DEFERRED=n
# CONFIG_LOG_DEFAULT_LEVEL=4
# CONFIG_DISPLAY_LOG_LEVEL_DBG=y
# CONFIG_SPI_LOG_LEVEL_DBG=y

# UART console for debug output (printk / printf)
CONFIG_CONSOLE=y
CONFIG_UART_CONSOLE=y
CONFIG_ESP_SPIRAM_HEAP_SIZE=0
```

## src/main.c
```c
/*
 * PicoCalc on ESP32-S3-Pico (Zephyr): minimal bring-up application.
 *
 * Brings up the display and runs the LCD and colour checks. Keys are handled by
 * keys_demo.c. This is the base for the Epsilon (NumWorks) port.
 *
 * SPDX-License-Identifier: Apache-2.0
 */

#include <stdio.h>

#include <zephyr/device.h>
#include <zephyr/devicetree.h>
#include <zephyr/drivers/display.h>
#include <zephyr/kernel.h>

#include "color_probe.h"
#include "display_test.h"
#include "keys.h"
#include "lcd.h"
#include "lcd_demo.h"

#ifdef CONFIG_EPSILON
extern void epsilon_start(void);
#endif

int main(void)
{
	const struct device *display_dev = DEVICE_DT_GET(DT_CHOSEN(zephyr_display));

	if (!device_is_ready(display_dev)) {
		printk("Display not ready, aborting\n");
		return 0;
	}

	k_sleep(K_MSEC(100));
	display_blanking_off(display_dev);
	printk("PicoCalc ready on %s\n", CONFIG_BOARD_TARGET);

#ifdef CONFIG_EPSILON
	/* Run NumWorks Epsilon. It never returns. */
	if (lcd_init(display_dev) < 0) {
		printk("LCD init failed\n");
		return 0;
	}
	keys_init();
	printk("Starting Epsilon\n");
	epsilon_start();
	return 0;
#endif

	/* Display bring-up test; remove once the display path is verified. */
	if (display_test_run(display_dev) < 0) {
		printk("Display test failed\n");
	}

	/* LCD layer check (Epsilon-style RGB565 drawing); runs after the raw test. */
	k_sleep(K_MSEC(1500));
	if (lcd_demo_run(display_dev) < 0) {
		printk("LCD demo failed\n");
	}

	/* Colour probe: shown a few seconds after the LCD demo. */
	k_sleep(K_MSEC(8000));
	if (color_probe_run(display_dev) < 0) {
		printk("Colour probe failed\n");
	}

	/* Keys are handled by the thread in keys_demo.c, started at boot. */
	while (1) {
		k_sleep(K_FOREVER);
	}

	return 0;
}
```

## src/color_probe.c
```c
/*
 * Colour probe. See color_probe.h.
 *
 * SPDX-License-Identifier: Apache-2.0
 */

#include <errno.h>
#include <stddef.h>
#include <stdint.h>

#include <zephyr/drivers/display.h>
#include <zephyr/kernel.h>
#include <zephyr/sys/util.h>

#include "color_probe.h"
#include "lcd.h" /* LCD_SWAP_RB */

#define PANEL_W   320
#define PANEL_H   320
#define CELL      40
#define NCOLORS   8
#define MAX_BYTES (PANEL_W * 8 * 3) /* largest strip written in one call */

struct rgb {
	uint8_t r, g, b;
};

/* Left to right in every row. */
static const struct rgb colors[NCOLORS] = {
	{0, 0, 0},     {255, 0, 0},   {0, 255, 0},   {0, 0, 255},
	{0, 255, 255}, {255, 0, 255}, {255, 255, 0}, {255, 255, 255},
};

static uint8_t buf[MAX_BYTES > CELL * CELL * 3 ? MAX_BYTES : CELL * CELL * 3];
static uint8_t big[PANEL_W * CELL * 3];
static enum display_pixel_format fmt;
static int bpp;

static void put(uint8_t *p, struct rgb c)
{
	if (LCD_SWAP_RB) {
		uint8_t t = c.r;

		c.r = c.b;
		c.b = t;
	}
	if (fmt == PIXEL_FORMAT_RGB_565) {
		uint16_t v = (uint16_t)(((c.r & 0xF8) << 8) | ((c.g & 0xFC) << 3) | (c.b >> 3));

		p[0] = (uint8_t)(v >> 8);
		p[1] = (uint8_t)(v & 0xFF);
	} else {
		p[0] = c.r;
		p[1] = c.g;
		p[2] = c.b;
	}
}

/* Logical (x, y) with (0, 0) top-left as the user sees it: flip like the LCD layer. */
static int write_rect(const struct device *dev, int x, int y, int w, int h, const uint8_t *data)
{
	const struct display_buffer_descriptor d = {
		.buf_size = (uint32_t)w * h * bpp,
		.width = w,
		.height = h,
		.pitch = w,
	};

	return display_write(dev, PANEL_W - x - w, PANEL_H - y - h, &d, data);
}

/* Uniform cell written in pieces of (pw x ph). */
static int cell(const struct device *dev, int x, int y, struct rgb c, int pw, int ph)
{
	for (int i = 0; i < pw * ph; i++) {
		put(&buf[i * bpp], c);
	}
	for (int yy = 0; yy < CELL; yy += ph) {
		for (int xx = 0; xx < CELL; xx += pw) {
			int r = write_rect(dev, x + xx, y + yy, pw, ph, buf);

			if (r < 0) {
				return r;
			}
		}
	}
	return 0;
}

int color_probe_run(const struct device *dev)
{
	struct display_capabilities caps;
	int r;

	display_get_capabilities(dev, &caps);
	fmt = caps.current_pixel_format;
	bpp = fmt == PIXEL_FORMAT_RGB_888 ? 3 : (fmt == PIXEL_FORMAT_RGB_565 ? 2 : 0);
	if (bpp == 0) {
		return -ENOTSUP;
	}
	printk("color probe: %s, rows A..G, cells K R G B C M Y W\n",
	       bpp == 3 ? "RGB888" : "RGB565");

	for (int c = 0; c < NCOLORS; c++) {
		const int x = c * CELL;

		/* A: one write per cell. */
		r = cell(dev, x, 0 * CELL, colors[c], CELL, CELL);
		/* B: 40-wide, 8 rows per write. */
		r = r < 0 ? r : cell(dev, x, 1 * CELL, colors[c], CELL, 8);
		/* C: 40-wide, 1 row per write. */
		r = r < 0 ? r : cell(dev, x, 2 * CELL, colors[c], CELL, 1);
		/* D: 8-wide, 40 rows per write. */
		r = r < 0 ? r : cell(dev, x, 3 * CELL, colors[c], 8, CELL);
		/* F: 1-pixel-wide columns. */
		r = r < 0 ? r : cell(dev, x, 5 * CELL, colors[c], 1, CELL);
		if (r < 0) {
			printk("color probe: write failed (%d)\n", r);
			return r;
		}
	}

	/* E: 320x8 strips holding all eight colours. */
	for (int row = 0; row < 8; row++) {
		for (int x = 0; x < PANEL_W; x++) {
			/* Panel x runs right to left, so the colour order is reversed here. */
			put(&buf[(row * PANEL_W + x) * bpp], colors[(PANEL_W - 1 - x) / CELL]);
		}
	}
	for (int yy = 0; yy < CELL; yy += 8) {
		r = write_rect(dev, 0, 4 * CELL + yy, PANEL_W, 8, buf);
		if (r < 0) {
			return r;
		}
	}

	/* G: one 320x40 write holding all eight colours. */
	for (int row = 0; row < CELL; row++) {
		for (int x = 0; x < PANEL_W; x++) {
			put(&big[(row * PANEL_W + x) * bpp], colors[(PANEL_W - 1 - x) / CELL]);
		}
	}
	r = write_rect(dev, 0, 6 * CELL, PANEL_W, CELL, big);
	printk("color probe done\n");
	return r < 0 ? r : 0;
}
```

## src/color_probe.h
```c
/*
 * Colour probe: draws the same eight colours with different write sizes so that a
 * colour problem can be traced to the way pixels are sent. Uses display_write()
 * directly, without the LCD layer.
 *
 * SPDX-License-Identifier: Apache-2.0
 */

#pragma once

#include <zephyr/device.h>

/*
 * Draws seven rows, 40 pixels tall each, top to bottom. Every row shows eight
 * 40-pixel-wide cells, left to right:
 *   black, red, green, blue, cyan, magenta, yellow, white
 * Rows differ only in how the pixels are sent:
 *   A: one write per cell (40x40)      E: 320x8 strips, all colours in one write
 *   B: 40-wide, 8 rows per write       F: 1-pixel-wide columns
 *   C: 40-wide, 1 row per write        G: one 320x40 write, all colours
 *   D: 8-wide, 40 rows per write
 */
int color_probe_run(const struct device *display_dev);
```

## src/display_test.c
```c
/*
 * Display bring-up test for the PicoCalc, drawing directly with display_write().
 *
 * SPDX-License-Identifier: Apache-2.0
 */

#include <errno.h>
#include <stddef.h>
#include <stdint.h>

#include <zephyr/drivers/display.h>
#include <zephyr/kernel.h>
#include <zephyr/sys/util.h>

#include "display_test.h"

#define MAX_WIDTH    480 /* widest rectangle fill_rect() can write */
#define STRIP_LINES  8   /* rows sent per display_write() call */
#define MAX_BPP      3   /* RGB888 */
#define MARKER_SIZE  24
#define HOLD_MS      700

/*
 * The visible panel is 320x320, whatever the driver reports (the ILI9488 driver
 * reports its full 320x480 memory, of which only the first 320 rows are shown).
 *
 * The panel is mounted rotated 180 degrees relative to the controller's scan
 * with rotation = <0>. The driver's own rotation = <180> shifts the picture by
 * 160 rows on this panel, so the flip is done here instead: a logical rectangle
 * (x, y, w, h) is written at its mirrored position. If the picture is mirrored
 * left-right or upside down, change these two flags.
 */
#define PANEL_W  320
#define PANEL_H  320
#define FLIP_X   1
#define FLIP_Y   1

struct rgb {
	uint8_t r;
	uint8_t g;
	uint8_t b;
};

static const struct rgb k_black = {0, 0, 0};
static const struct rgb k_white = {255, 255, 255};

/* Colour bars, top to bottom. */
static const struct rgb k_bands[] = {
	{255, 255, 255}, /* white */
	{255, 255, 0},   /* yellow */
	{0, 255, 255},   /* cyan */
	{0, 255, 0},     /* green */
	{255, 0, 255},   /* magenta */
	{255, 0, 0},     /* red */
	{0, 0, 255},     /* blue */
	{0, 0, 0},       /* black */
};

static uint8_t strip[MAX_WIDTH * STRIP_LINES * MAX_BPP];

static int bytes_per_pixel(enum display_pixel_format fmt)
{
	switch (fmt) {
	case PIXEL_FORMAT_RGB_888:
		return 3;
	case PIXEL_FORMAT_RGB_565:
		return 2;
	default:
		return 0;
	}
}

static void put_pixel(uint8_t *p, enum display_pixel_format fmt, struct rgb c)
{
	if (fmt == PIXEL_FORMAT_RGB_888) {
		p[0] = c.r;
		p[1] = c.g;
		p[2] = c.b;
	} else {
		/* RGB565, big-endian byte order as documented by Zephyr. */
		uint16_t v = (uint16_t)(((c.r & 0xF8) << 8) | ((c.g & 0xFC) << 3) | (c.b >> 3));

		p[0] = (uint8_t)(v >> 8);
		p[1] = (uint8_t)(v & 0xFF);
	}
}

/* Fill a rectangle with one colour, STRIP_LINES rows per display_write(). */
static int fill_rect(const struct device *dev, enum display_pixel_format fmt,
		     uint16_t x, uint16_t y, uint16_t w, uint16_t h, struct rgb c)
{
	const int bpp = bytes_per_pixel(fmt);

	if (w == 0 || h == 0) {
		return 0;
	}
	if (bpp == 0 || w > MAX_WIDTH) {
		return -ENOTSUP;
	}

	for (uint32_t i = 0; i < (uint32_t)w * STRIP_LINES; i++) {
		put_pixel(&strip[i * bpp], fmt, c);
	}

	if (FLIP_X) {
		x = PANEL_W - x - w;
	}
	if (FLIP_Y) {
		y = PANEL_H - y - h;
	}

	for (uint16_t row = 0; row < h; row += STRIP_LINES) {
		const uint16_t lines = MIN(STRIP_LINES, h - row);
		const struct display_buffer_descriptor desc = {
			.buf_size = (uint32_t)w * lines * bpp,
			.width = w,
			.height = lines,
			.pitch = w,
		};
		int ret = display_write(dev, x, y + row, &desc, strip);

		if (ret < 0) {
			return ret;
		}
	}

	return 0;
}

int display_test_run(const struct device *display_dev)
{
	struct display_capabilities caps;
	int ret;

	display_get_capabilities(display_dev, &caps);

	const enum display_pixel_format fmt = caps.current_pixel_format;
	const uint16_t w = PANEL_W;
	const uint16_t h = PANEL_H;

	printk("display: driver reports %ux%u, using %ux%u, pixel format 0x%x, %d bytes/pixel\n",
	       (unsigned int)caps.x_resolution, (unsigned int)caps.y_resolution,
	       (unsigned int)w, (unsigned int)h, (unsigned int)fmt, bytes_per_pixel(fmt));

	if (bytes_per_pixel(fmt) == 0) {
		printk("display test: unsupported pixel format\n");
		return -ENOTSUP;
	}

	/* 1. Solid fills, timing each full-screen push. */
	static const struct rgb solid[] = {{255, 0, 0}, {0, 255, 0}, {0, 0, 255}};
	static const char *const names[] = {"red", "green", "blue"};

	for (size_t i = 0; i < ARRAY_SIZE(solid); i++) {
		const int64_t t0 = k_uptime_get();

		ret = fill_rect(display_dev, fmt, 0, 0, w, h, solid[i]);
		if (ret < 0) {
			printk("display test: %s fill failed (%d)\n", names[i], ret);
			return ret;
		}

		printk("%s fill: full-screen push took %u ms\n", names[i],
		       (unsigned int)(k_uptime_get() - t0));
		k_msleep(HOLD_MS);
	}

	/* 2. Colour bands plus corner markers. */
	const uint16_t band_h = h / ARRAY_SIZE(k_bands);

	for (size_t i = 0; i < ARRAY_SIZE(k_bands); i++) {
		const uint16_t y = (uint16_t)(i * band_h);
		const uint16_t bh = (i == ARRAY_SIZE(k_bands) - 1) ? (uint16_t)(h - y) : band_h;

		ret = fill_rect(display_dev, fmt, 0, y, w, bh, k_bands[i]);
		if (ret < 0) {
			printk("display test: band %u failed (%d)\n", (unsigned int)i, ret);
			return ret;
		}
	}

	ret = fill_rect(display_dev, fmt, 0, 0, MARKER_SIZE, MARKER_SIZE, k_black);
	if (ret < 0) {
		return ret;
	}
	ret = fill_rect(display_dev, fmt, w - MARKER_SIZE, h - MARKER_SIZE,
			MARKER_SIZE, MARKER_SIZE, k_white);
	if (ret < 0) {
		return ret;
	}

	/*
	 * 3. Ruler to measure any horizontal offset or dead strip: 8-pixel blocks
	 * across the full width, in two rows. Block 0 (left edge) is red and the
	 * last block (right edge) is green; the rest alternate white and black.
	 * The second row is offset by one block so the pattern is easy to count.
	 */
	const uint16_t nblocks = w / 8;

	for (uint16_t row = 0; row < 2; row++) {
		for (uint16_t i = 0; i < nblocks; i++) {
			struct rgb c = ((i + row) & 1) ? k_white : k_black;

			if (i == 0) {
				c = (struct rgb){255, 0, 0};
			} else if (i == nblocks - 1) {
				c = (struct rgb){0, 255, 0};
			}
			ret = fill_rect(display_dev, fmt, i * 8, 48 + row * 16, 8, 16, c);
			if (ret < 0) {
				return ret;
			}
		}
	}
	printk("ruler: %u blocks of 8 px, red = left edge, green = right edge\n", nblocks);

	printk("display test done\n");
	return 0;
}
```

## src/display_test.h
```c
/*
 * Display bring-up test for the PicoCalc, drawing directly with display_write().
 *
 * SPDX-License-Identifier: Apache-2.0
 */

#pragma once

#include <zephyr/device.h>

/*
 * Draws, in order:
 *   1. full-screen solid red, green and blue (about 0.7 s each), printing how
 *      long each full-screen push took on the console;
 *   2. eight horizontal colour bands, top to bottom: white, yellow, cyan,
 *      green, magenta, red, blue, black. A black square marks the top-left
 *      corner and a white square marks the bottom-right corner.
 *
 * Supports the RGB888 and RGB565 pixel formats. Returns 0 on success or a
 * negative errno value.
 */
int display_test_run(const struct device *display_dev);
```

## src/keyboard.c
```c
//
//  PicoCalc keyboard driver
//
//  This driver implements a simple keyboard interface for the PicoCalc
//  using the I2C bus. It handles key presses and releases, modifier keys,
//  and user interrupts.
//
//  The PicoCalc only allows for polling the keyboard, and the API is
//  limited. To support user interrupts, we need to poll the keyboard and
//  buffer the key events for when needed, except for the user interrupt
//  where we process it immediately. We use a semaphore to protect access
//  to the I2C bus and a repeating timer to poll for the key events.
//
//  We also provide functions to interact with other features in the system,
//  such as reading the battery level.
//


#include "keyboard.h"
#include "southbridge.h"
volatile bool user_interrupt;
keyboard_key_available_callback_t keyboard_key_available_callback = NULL;

static bool keyboard_initialised = false; // flag to indicate if the keyboard is initialised

// Modifier key states
static bool key_control = false; // control key state
static bool key_shift = false;   // shift key state
static bool key_alt = false;     // alt key state

static volatile char rx_buffer[KBD_BUFFER_SIZE];
static volatile uint16_t rx_head = 0;
static volatile uint16_t rx_tail = 0;

//
//  Keyboard Driver
//
//  This section implements the keyboard driver, which polls the
//  keyboard for key events and buffers them for processing. It uses
//  a repeating timer to poll the keyboard at regular intervals.
//

void keyboard_poll()
{

    uint16_t key = sb_read_keyboard();
    uint8_t key_state = (key >> 8) & 0xFF;
    uint8_t key_code = key & 0xFF;
    // printf("KeyVal = %d %d %d",key,key_state,key_code);
    if (key_state != 0)
    {
        if (key_state == KEY_STATE_PRESSED)
        {
            if (key_code == KEY_MOD_CTRL)
            {
                key_control = true;
            }
            else if (key_code == KEY_MOD_SHL || key_code == KEY_MOD_SHR)
            {
                key_shift = true;
            }
            else if (key_code == KEY_MOD_ALT)
            {
                key_alt = true;
            }
            else if (key_code == KEY_BREAK)
            {
                user_interrupt = true; // set user interrupt flag
            }
            else if (key_code == KEY_CAPS_LOCK)
            {
                // do nothing, processed in the south bridge
            }
            else
            {
                // If a key is released, we return the key code
                // This allows us to handle the key release in the main loop
                uint8_t ch = key_code;
                if (ch >= 'a' && ch <= 'z') // Ctrl and Shift handling
                {
                    if (key_control)
                    {
                        ch &= 0x1F; // convert to control character
                    }
                    if (key_shift)
                    {
                        ch &= ~0x20;
                    }
                }
                else if (ch == KEY_ENTER) // enter key is returned as LF
                {
                    ch = KEY_RETURN; // convert LF to CR
                }

                uint16_t next_head = (rx_head + 1) & (KBD_BUFFER_SIZE - 1);
                rx_buffer[rx_head] = ch;
                rx_head = next_head;

                // Notify that characters are available
                if (keyboard_key_available_callback)
                {
                    keyboard_key_available_callback();
                }
            }
        }
        else if (key_state == KEY_STATE_RELEASED)
        {
            if (key_code == KEY_MOD_CTRL)
            {
                key_control = false;
            }
            else if (key_code == KEY_MOD_SHL || key_code == KEY_MOD_SHR)
            {
                key_shift = false;
            }
        }
    }

}

//
// Keyboard API
//

bool keyboard_key_available()
{
    return rx_head != rx_tail;
}

char keyboard_get_key()
{
    while (!keyboard_key_available())
    {
        // tight_loop_contents();
    }

    char ch = rx_buffer[rx_tail];
    rx_tail = (rx_tail + 1) & (KBD_BUFFER_SIZE - 1);
    return ch;
}


//
// Keyboard Callback Setters
//

void keyboard_set_key_available_callback(keyboard_key_available_callback_t callback)
{
    keyboard_key_available_callback = callback;
}


//
//  Initialize the keyboard driver
//

void keyboard_init(void)
{
    if (keyboard_initialised)
    {
        return; // already initialized
    }

    // Initialize the south bridge if not already done
    sb_init(); // Initialize the south bridge

    keyboard_initialised = true;
}
```

## src/keyboard.h
```c
#pragma once

#include <stdbool.h>
#include <stdint.h>
#include <stddef.h>

// Keyboard key definitions
#define KEY_MOD_ALT         (0xA1)
#define KEY_MOD_SHL         (0xA2)
#define KEY_MOD_SHR         (0xA3)
#define KEY_MOD_SYM         (0xA4)
#define KEY_MOD_CTRL        (0xA5)

#define KEY_STATE_IDLE      (0)
#define KEY_STATE_PRESSED   (1)
#define KEY_STATE_HOLD      (2)
#define KEY_STATE_RELEASED  (3)

#define KEY_BACKSPACE       (0x08)
#define KEY_TAB             (0x09)
#define KEY_ENTER           (0x0A)
#define KEY_RETURN          (0x0D)
#define KEY_SPACE           (0x20)

#define KEY_ESC             (0xB1)
#define KEY_UP              (0xB5)
#define KEY_DOWN            (0xB6)
#define KEY_LEFT            (0xB4)
#define KEY_RIGHT           (0xB7)

#define KEY_BREAK           (0xD0)
#define KEY_INSERT          (0xD1)
#define KEY_HOME            (0xD2)
#define KEY_DEL             (0xD4)
#define KEY_END             (0xD5)
#define KEY_PAGE_UP         (0xD6)
#define KEY_PAGE_DOWN       (0xD7)

#define KEY_CAPS_LOCK       (0xC1)

#define KEY_F1              (0x81)
#define KEY_F2              (0x82)
#define KEY_F3              (0x83)
#define KEY_F4              (0x84)
#define KEY_F5              (0x85)
#define KEY_F6              (0x86)
#define KEY_F7              (0x87)
#define KEY_F8              (0x88)
#define KEY_F9              (0x89)
#define KEY_F10             (0x90)

#define KEY_POWER           (0x91)

// Keyboard defaults
#define KBD_BUFFER_SIZE     (32)
#define KEYBOARD_POLL_MS    (100) // poll keyboard every 100 ms


// Callback function type for when a key becomes available
typedef void (*keyboard_key_available_callback_t)(void);

// Keyboard Function prototypes
void keyboard_init(void);
void keyboard_set_key_available_callback(keyboard_key_available_callback_t callback);
void keyboard_poll(void);
bool keyboard_key_available(void);
char keyboard_get_key(void);
```

## src/keys.c
```c
/*
 * PicoCalc keys for Epsilon. See keys.h.
 *
 * SPDX-License-Identifier: Apache-2.0
 */

#include <stdint.h>

#include <zephyr/kernel.h>

#include "keys.h"
#include "southbridge.h"

/* Set to 1 to print every southbridge event (state, code) on the console. */
#define KEYS_DEBUG_EVENTS 1

/* Enough to drain a burst of key changes in one go without hogging the I2C bus. */
#define MAX_EVENTS_PER_POLL 16

void keys_init(void)
{
	sb_init();
	keys_core_reset();
}

int keys_poll(void)
{
	int n = 0;

	while (n < MAX_EVENTS_PER_POLL && sb_available()) {
		const uint16_t ev = sb_read_keyboard();
		const uint8_t state = (uint8_t)(ev >> 8);
		const uint8_t code = (uint8_t)(ev & 0xFF);

		if (state == 0) {
			break; /* FIFO empty (or an I2C error) */
		}
#if KEYS_DEBUG_EVENTS
		printk("sb event: state %u code 0x%02x\n", state, code);
#endif
		keys_core_event(state, code);
		n++;
	}
	return n;
}
```

## src/keys.h
```c
/*
 * PicoCalc keys for Epsilon: polls the southbridge and keeps the held-key bitmap.
 *
 * SPDX-License-Identifier: Apache-2.0
 */

#pragma once

#include <stdint.h>

#include "keys_core.h"

/* Bring up the southbridge and clear the held-key state. */
void keys_init(void);

/* Read pending southbridge key events and update the state. Returns how many were read. */
int keys_poll(void);

/* Keys held right now, as an Epsilon Ion keyboard state bitmap. */
static inline uint64_t keys_state(void)
{
	return keys_core_state();
}
```

## src/keys_core.c
```c
/*
 * PicoCalc key events to NumWorks key state. See keys_core.h.
 *
 * Layout (PicoCalc key -> NumWorks key):
 *   arrows -> arrows, Enter -> OK, Esc -> Back, Home/F1 -> Home,
 *   Backspace/Del -> Backspace, either Shift -> Shift, Alt -> Alpha, Power -> OnOff,
 *   0-9 . , + - * / ( ) ^ -> the same keys, '=' -> EXE,
 *   s c t -> Sine Cosine Tangent,  l g e -> Ln Log Exp,  p r q -> Pi Sqrt Square,
 *   i x v b -> Imaginary XNT Var Toolbox,  a n -> Ans EE.
 * Letters work in either case, because Shift changes the letter the southbridge reports.
 *
 * SPDX-License-Identifier: Apache-2.0
 */

#include <stdatomic.h>
#include <stdbool.h>
#include <stddef.h>
#include <stdint.h>
#include <stdio.h>

#include "keys_core.h"
#include "numworks_keys.h"

/* PicoCalc key codes (see keyboard.h). */
#define PC_BACKSPACE 0x08
#define PC_ENTER     0x0A
#define PC_RETURN    0x0D
#define PC_F1        0x81
#define PC_POWER     0x91
#define PC_MOD_ALT   0xA1
#define PC_MOD_SHL   0xA2
#define PC_MOD_SHR   0xA3
#define PC_ESC       0xB1
#define PC_LEFT      0xB4
#define PC_UP        0xB5
#define PC_DOWN      0xB6
#define PC_RIGHT     0xB7
#define PC_HOME      0xD2
#define PC_DEL       0xD4

struct map {
	uint8_t code;
	uint8_t key; /* enum nw_key */
};

static const struct map key_map[] = {
	{PC_LEFT, NW_Left}, {PC_UP, NW_Up}, {PC_DOWN, NW_Down}, {PC_RIGHT, NW_Right},
	{PC_ENTER, NW_OK}, {PC_RETURN, NW_OK}, {PC_ESC, NW_Back},
	{PC_HOME, NW_Home}, {PC_F1, NW_Home},
	{PC_BACKSPACE, NW_Backspace}, {PC_DEL, NW_Backspace},
	{PC_MOD_ALT, NW_Alpha},
	{PC_POWER, NW_OnOff},
	{'0', NW_Zero}, {'1', NW_One}, {'2', NW_Two}, {'3', NW_Three}, {'4', NW_Four},
	{'5', NW_Five}, {'6', NW_Six}, {'7', NW_Seven}, {'8', NW_Eight}, {'9', NW_Nine},
	{'.', NW_Dot}, {',', NW_Comma}, {'+', NW_Plus}, {'-', NW_Minus},
	{'*', NW_Multiplication}, {'/', NW_Division},
	{'(', NW_LeftParenthesis}, {')', NW_RightParenthesis}, {'^', NW_Power},
	{'=', NW_EXE},
	{'s', NW_Sine}, {'c', NW_Cosine}, {'t', NW_Tangent},
	{'l', NW_Ln}, {'g', NW_Log}, {'e', NW_Exp},
	{'p', NW_Pi}, {'r', NW_Sqrt}, {'q', NW_Square},
	{'i', NW_Imaginary}, {'x', NW_XNT}, {'v', NW_Var}, {'b', NW_Toolbox},
	{'a', NW_Ans}, {'n', NW_EE},
};

/* With Shift held the southbridge reports the shifted symbol, but if Shift is let go
 * before the key, the release comes with the plain symbol. Each pair here is the same
 * physical key, so both codes must clear both keys, otherwise a key can stay stuck. */
static const struct {
	uint8_t a, b;
} same_physical_key[] = {
	{'(', '9'}, {')', '0'}, {'*', '8'}, {'+', '='}, {'^', '6'},
};

/* NumWorks' Shift is a tap, then the next key. The PicoCalc Shift is held while the next
 * key is typed, and symbols such as ^ or + already arrive as the shifted character. So
 * the held Shift is never passed on. It only becomes a short Shift tap when it was
 * pressed and released without any other key in between. */
#define SHIFT_TAP_POLLS 8
static _Atomic bool shift_down;
static _Atomic bool shift_used;
static _Atomic int shift_tap;

static void shift_event(uint8_t state)
{
	if (state == KEYS_EVENT_PRESSED) {
		atomic_store(&shift_used, false);
		atomic_store(&shift_down, true);
	} else if (state == KEYS_EVENT_RELEASED) {
		atomic_store(&shift_down, false);
		if (!atomic_load(&shift_used)) {
			atomic_store(&shift_tap, SHIFT_TAP_POLLS);
		}
	}
}

static _Atomic uint32_t state_lo; /* keys 0..31 */
static _Atomic uint32_t state_hi; /* keys 32..63 */

static int lookup(uint8_t code)
{
	if (code >= 'A' && code <= 'Z') {
		code = (uint8_t)(code + ('a' - 'A'));
	}
	for (size_t i = 0; i < sizeof(key_map) / sizeof(key_map[0]); i++) {
		if (key_map[i].code == code) {
			return key_map[i].key;
		}
	}
	return -1;
}

static uint8_t sibling(uint8_t code)
{
	for (size_t i = 0; i < sizeof(same_physical_key) / sizeof(same_physical_key[0]); i++) {
		if (same_physical_key[i].a == code) {
			return same_physical_key[i].b;
		}
		if (same_physical_key[i].b == code) {
			return same_physical_key[i].a;
		}
	}
	return 0;
}

static void set_key(int key, bool down)
{
	_Atomic uint32_t *word = key < 32 ? &state_lo : &state_hi;
	const uint32_t bit = (uint32_t)1 << (key & 31);

	if (down) {
		atomic_fetch_or(word, bit);
	} else {
		atomic_fetch_and(word, ~bit);
	}
}

void keys_core_reset(void)
{
	atomic_store(&state_lo, 0);
	atomic_store(&state_hi, 0);
	atomic_store(&shift_down, false);
	atomic_store(&shift_used, false);
	atomic_store(&shift_tap, 0);
}

void keys_core_event(uint8_t state, uint8_t code)
{
	int key;

	if (code == PC_MOD_SHL || code == PC_MOD_SHR) {
		shift_event(state);
		return;
	}
	key = lookup(code);
	if (state == KEYS_EVENT_PRESSED && atomic_load(&shift_down)) {
		atomic_store(&shift_used, true);
	}

	if (state == KEYS_EVENT_PRESSED || state == KEYS_EVENT_HOLD) {
		if (key >= 0) {
			set_key(key, true);
		}
	} else if (state == KEYS_EVENT_RELEASED) {
		if (key >= 0) {
			set_key(key, false);
		}
		uint8_t other = sibling(code);

		if (other != 0 && lookup(other) >= 0) {
			set_key(lookup(other), false);
		}
	}
}

uint64_t keys_core_state(void)
{
	/* Each word is read on its own: the keys are independent bits, so a snapshot
	 * taken across an update is still a valid combination of held keys. */
	const uint64_t hi = atomic_load(&state_hi);
	const uint64_t lo = atomic_load(&state_lo);

	uint64_t all = (hi << 32) | lo;
	int tap = atomic_load(&shift_tap);

	if (tap > 0) {
		atomic_store(&shift_tap, tap - 1);
		all |= (uint64_t)1 << NW_Shift;
	}
	return all;
}

size_t keys_core_describe(uint64_t state, char *buf, size_t size)
{
	size_t n = 0;

	if (size == 0) {
		return 0;
	}
	buf[0] = '\0';
	for (int k = 0; k < NW_KEY_SLOTS; k++) {
		if (((state >> k) & 1) && nw_key_names[k] != NULL) {
			int w = snprintf(buf + n, size - n, "%s%s", n ? "+" : "", nw_key_names[k]);

			if (w < 0 || (size_t)w >= size - n) {
				break;
			}
			n += (size_t)w;
		}
	}
	return n;
}
```

## src/keys_core.h
```c
/*
 * PicoCalc key events to NumWorks key state.
 *
 * Turns the PicoCalc southbridge's key events (state + code) into the set of
 * NumWorks keys currently held down, as the 64-bit bitmap Epsilon's
 * Ion::Keyboard::State uses (bit = row * 6 + column). No hardware access here, so
 * it can be tested on a computer.
 *
 * SPDX-License-Identifier: Apache-2.0
 */

#pragma once

#include <stddef.h>
#include <stdint.h>

/* Southbridge event states. */
#define KEYS_EVENT_PRESSED  1
#define KEYS_EVENT_HOLD     2
#define KEYS_EVENT_RELEASED 3

void keys_core_reset(void);

/* Feed one southbridge event. Unknown keys and the idle state (0) are ignored. */
void keys_core_event(uint8_t state, uint8_t code);

/* Keys currently held, as an Epsilon Ion keyboard state bitmap. */
uint64_t keys_core_state(void);

/* Write the names of the keys in `state` (for example "Shift+Sine") into buf. */
size_t keys_core_describe(uint64_t state, char *buf, size_t size);
```

## src/keys_demo.c
```c
/*
 * Key layer check: a background thread polls the keys and prints the NumWorks keys
 * held down whenever they change. This is also how Epsilon's keyboard backend will
 * be driven.
 *
 * SPDX-License-Identifier: Apache-2.0
 */

#include <stdint.h>

#include <zephyr/kernel.h>

#include "keys.h"

#define KEYS_POLL_MS 10

/* With Epsilon the keys are read by its Ion backend instead. */
#ifndef CONFIG_EPSILON

static void keys_demo_thread(void *a, void *b, void *c)
{
	uint64_t last = 0;
	char names[96];

	(void)a;
	(void)b;
	(void)c;

	keys_init();
	printk("keys: ready, press keys\n");

	while (1) {
		keys_poll();

		const uint64_t now = keys_state();

		if (now != last) {
			keys_core_describe(now, names, sizeof(names));
			printk("keys held: %08x%08x  %s\n", (unsigned int)(now >> 32),
			       (unsigned int)now, names[0] ? names : "(none)");
			last = now;
		}
		k_msleep(KEYS_POLL_MS);
	}
}

K_THREAD_DEFINE(keys_demo_tid, 4096, keys_demo_thread, NULL, NULL, NULL, 7, 0, 0);

#endif /* !CONFIG_EPSILON */
```

## src/lcd.c
```c
/*
 * PicoCalc LCD layer for the Epsilon (NumWorks) port. See lcd.h.
 *
 * SPDX-License-Identifier: Apache-2.0
 */

#include <errno.h>
#include <stdbool.h>
#include <stddef.h>
#include <stdint.h>
#include <string.h>

#include <zephyr/drivers/display.h>
#include <zephyr/kernel.h>
#include <zephyr/sys/util.h>

#include "lcd.h"

/* Physical panel: 320x320 shown part of the ILI9488's 320x480 memory. */
#define PANEL_W 320
#define PANEL_H 320

/* The panel is mounted rotated 180 degrees against the controller's scan, and the
 * driver's own rotation shifts the picture, so the flip is done here. */
#define FLIP_X 0
#define FLIP_Y 0

/* Epsilon's 240 rows are centred on the 320-row panel. */
#define Y_OFFSET ((PANEL_H - LCD_HEIGHT) / 2)

/* Widest wire format: RGB888, 3 bytes per pixel. The chunk buffer is sized for it. */
#define MAX_BPP 3

/* Pixels converted and sent per display_write(). Internal RAM, so SPI DMA can use it. */
#define CHUNK_PIXELS 8192

#ifdef CONFIG_ESP_SPIRAM
#define IN_PSRAM __attribute__((section(".ext_ram.bss.lcd_shadow")))
#else
#define IN_PSRAM
#endif

static const struct device *dev;
static uint16_t shadow[LCD_WIDTH * LCD_HEIGHT] IN_PSRAM;
static uint8_t chunk[CHUNK_PIXELS * MAX_BPP];

/* Wire format the panel was configured with (devicetree pixel-format). */
static enum display_pixel_format wire_format;
static int bpp;

/* Encode one RGB565 pixel for the panel (red and blue swapped, see LCD_SWAP_RB).
 * RGB888: the panel only uses the top 6 bits of each byte, and the low bits are
 * filled so white stays white. RGB565: Zephyr's big-endian byte order. */
static inline void encode_pixel(uint16_t v, uint8_t *out)
{
	if (LCD_SWAP_RB) {
		/* Swap the 5-bit red and blue fields of the RGB565 value. */
		v = (uint16_t)(((v & 0x1F) << 11) | (v & 0x07E0) | (v >> 11));
	}
	if (wire_format == PIXEL_FORMAT_RGB_565) {
		out[0] = (uint8_t)(v >> 8);
		out[1] = (uint8_t)(v & 0xFF);
	} else {
		uint8_t r = (v >> 8) & 0xF8;
		uint8_t g = (v >> 3) & 0xFC;
		uint8_t b = (v << 3) & 0xF8;

		out[0] = r | (r >> 5);
		out[1] = g | (g >> 6);
		out[2] = b | (b >> 5);
	}
}

/* Intersect a logical rectangle with the screen. Returns false when nothing is left. */
static bool clip(int *x, int *y, int *w, int *h, int *skip_x, int *skip_y)
{
	int x0 = *x, y0 = *y, x1 = *x + *w, y1 = *y + *h;

	if (*w <= 0 || *h <= 0) {
		return false;
	}
	if (x0 < 0) {
		x0 = 0;
	}
	if (y0 < 0) {
		y0 = 0;
	}
	if (x1 > LCD_WIDTH) {
		x1 = LCD_WIDTH;
	}
	if (y1 > LCD_HEIGHT) {
		y1 = LCD_HEIGHT;
	}
	if (x0 >= x1 || y0 >= y1) {
		return false;
	}
	*skip_x = x0 - *x;
	*skip_y = y0 - *y;
	*x = x0;
	*y = y0;
	*w = x1 - x0;
	*h = y1 - y0;
	return true;
}

/* Physical top-left and size of a logical rectangle on the panel. */
static void to_panel(int x, int y, int w, int h, int *px, int *py)
{
	const int ly = y + Y_OFFSET;

	*px = FLIP_X ? PANEL_W - x - w : x;
	*py = FLIP_Y ? PANEL_H - ly - h : ly;
}

static int panel_write(int px, int py, int w, int rows)
{
	const struct display_buffer_descriptor desc = {
		.buf_size = (uint32_t)w * rows * bpp,
		.width = w,
		.height = rows,
		.pitch = w,
	};

	return display_write(dev, px, py, &desc, chunk);
}

/* Send a logical rectangle of the shadow copy to the panel. */
static void flush_shadow(int x, int y, int w, int h)
{
	int px, py;

	to_panel(x, y, w, h, &px, &py);

	const int rows_per_chunk = MAX(1, CHUNK_PIXELS / w);

	for (int done = 0; done < h; done += rows_per_chunk) {
		const int rows = MIN(rows_per_chunk, h - done);

		for (int r = 0; r < rows; r++) {
			/* Panel rows run top to bottom; with FLIP_Y that is logical bottom to top. */
			const int ly = FLIP_Y ? y + h - 1 - (done + r) : y + done + r;
			const uint16_t *src = &shadow[ly * LCD_WIDTH + x];
			uint8_t *dst = &chunk[r * w * bpp];

			if (FLIP_X) {
				for (int i = 0; i < w; i++) {
					encode_pixel(src[w - 1 - i], &dst[i * bpp]);
				}
			} else {
				for (int i = 0; i < w; i++) {
					encode_pixel(src[i], &dst[i * bpp]);
				}
			}
		}

		panel_write(px, py + done, w, rows);
	}
}

/* Fill a physical panel rectangle with one RGB565 colour. */
static void panel_fill(int px, int py, int w, int h, uint16_t color)
{
	const int rows_per_chunk = MAX(1, CHUNK_PIXELS / w);
	const int fill_rows = MIN(rows_per_chunk, h);
	uint8_t pixel[MAX_BPP];

	encode_pixel(color, pixel);
	for (int i = 0; i < w * fill_rows; i++) {
		memcpy(&chunk[i * bpp], pixel, bpp);
	}
	for (int done = 0; done < h; done += rows_per_chunk) {
		panel_write(px, py + done, w, MIN(rows_per_chunk, h - done));
	}
}

int lcd_init(const struct device *display)
{
	struct display_capabilities caps;

	if (display == NULL || !device_is_ready(display)) {
		return -ENODEV;
	}
	display_get_capabilities(display, &caps);
	if (caps.current_pixel_format == PIXEL_FORMAT_RGB_888) {
		bpp = 3;
	} else if (caps.current_pixel_format == PIXEL_FORMAT_RGB_565) {
		bpp = 2;
	} else {
		return -ENOTSUP;
	}
	wire_format = caps.current_pixel_format;
	printk("lcd: wire format %s, %d bytes/pixel\n",
	       bpp == 3 ? "RGB888" : "RGB565", bpp);

	dev = display;
	memset(shadow, 0, sizeof(shadow));
	panel_fill(0, 0, PANEL_W, PANEL_H, 0x0000);
	return 0;
}

void lcd_push_rect(int x, int y, int w, int h, const uint16_t *pixels)
{
	const int src_w = w;
	int skip_x, skip_y;

	if (dev == NULL || !clip(&x, &y, &w, &h, &skip_x, &skip_y)) {
		return;
	}
	for (int r = 0; r < h; r++) {
		memcpy(&shadow[(y + r) * LCD_WIDTH + x],
		       &pixels[(skip_y + r) * src_w + skip_x], (size_t)w * sizeof(uint16_t));
	}
	flush_shadow(x, y, w, h);
}

void lcd_push_uniform(int x, int y, int w, int h, uint16_t color)
{
	int skip_x, skip_y, px, py;

	if (dev == NULL || !clip(&x, &y, &w, &h, &skip_x, &skip_y)) {
		return;
	}
	for (int r = 0; r < h; r++) {
		uint16_t *row = &shadow[(y + r) * LCD_WIDTH + x];

		for (int i = 0; i < w; i++) {
			row[i] = color;
		}
	}
	to_panel(x, y, w, h, &px, &py);
	panel_fill(px, py, w, h, color);
}

void lcd_pull_rect(int x, int y, int w, int h, uint16_t *pixels)
{
	const int out_w = w;
	int skip_x, skip_y;

	if (w > 0 && h > 0) {
		memset(pixels, 0, (size_t)w * h * sizeof(uint16_t));
	}
	if (dev == NULL || !clip(&x, &y, &w, &h, &skip_x, &skip_y)) {
		return;
	}
	for (int r = 0; r < h; r++) {
		memcpy(&pixels[(skip_y + r) * out_w + skip_x],
		       &shadow[(y + r) * LCD_WIDTH + x], (size_t)w * sizeof(uint16_t));
	}
}
```
